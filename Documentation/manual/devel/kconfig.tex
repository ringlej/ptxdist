## config/initramfs-busybox/mailutils/Config.in
```kconfig
menu "Mail Utilities"

config INITRAMFS_BUSYBOX_MAKEMIME
	bool "makemime"
	default n
	help
	  Create MIME-formatted messages.

config INITRAMFS_BUSYBOX_FEATURE_MIME_CHARSET
	string "Default charset"
	default "us-ascii"
	depends on INITRAMFS_BUSYBOX_MAKEMIME || INITRAMFS_BUSYBOX_REFORMIME || INITRAMFS_BUSYBOX_SENDMAIL
	help
	  Default charset of the message.

config INITRAMFS_BUSYBOX_POPMAILDIR
	bool "popmaildir"
	default n
	help
	  Simple yet powerful POP3 mail popper. Delivers content
	  of remote mailboxes to local Maildir.

config INITRAMFS_BUSYBOX_FEATURE_POPMAILDIR_DELIVERY
	bool "Allow message filters and custom delivery program"
	default n
	depends on INITRAMFS_BUSYBOX_POPMAILDIR
	help
	  Allow to use a custom program to filter the content
	  of the message before actual delivery (-F "prog [args...]").
	  Allow to use a custom program for message actual delivery
	  (-M "prog [args...]").

config INITRAMFS_BUSYBOX_REFORMIME
	bool "reformime"
	default n
	help
	  Parse MIME-formatted messages.

config INITRAMFS_BUSYBOX_FEATURE_REFORMIME_COMPAT
	bool "Accept and ignore options other than -x and -X"
	default y
	depends on INITRAMFS_BUSYBOX_REFORMIME
	help
	  Accept (for compatibility only) and ignore options
	  other than -x and -X.

config INITRAMFS_BUSYBOX_SENDMAIL
	bool "sendmail"
	default n
	help
	  Barebones sendmail.

endmenu
```

## config/initramfs-busybox/selinux/Config.in
```kconfig
#
# For a description of the syntax of this configuration file,
# see scripts/kbuild/config-language.txt.
#

menu "SELinux Utilities"
	depends on INITRAMFS_BUSYBOX_SELINUX

config INITRAMFS_BUSYBOX_CHCON
	bool "chcon"
	default n
	depends on INITRAMFS_BUSYBOX_SELINUX
	help
	  Enable support to change the security context of file.

config INITRAMFS_BUSYBOX_FEATURE_CHCON_LONG_OPTIONS
	bool "Enable long options"
	default y
	depends on INITRAMFS_BUSYBOX_CHCON && INITRAMFS_BUSYBOX_LONG_OPTS
	help
	  Support long options for the chcon applet.

config INITRAMFS_BUSYBOX_GETENFORCE
	bool "getenforce"
	default n
	depends on INITRAMFS_BUSYBOX_SELINUX
	help
	  Enable support to get the current mode of SELinux.

config INITRAMFS_BUSYBOX_GETSEBOOL
	bool "getsebool"
	default n
	depends on INITRAMFS_BUSYBOX_SELINUX
	help
	  Enable support to get SELinux boolean values.

config INITRAMFS_BUSYBOX_LOAD_POLICY
	bool "load_policy"
	default n
	depends on INITRAMFS_BUSYBOX_SELINUX
	help
	  Enable support to load SELinux policy.

config INITRAMFS_BUSYBOX_MATCHPATHCON
	bool "matchpathcon"
	default n
	depends on INITRAMFS_BUSYBOX_SELINUX
	help
	  Enable support to get default security context of the
	  specified path from the file contexts configuration.

config INITRAMFS_BUSYBOX_RESTORECON
	bool "restorecon"
	default n
	depends on INITRAMFS_BUSYBOX_SELINUX
	help
	  Enable support to relabel files. The feature is almost
	  the same as setfiles, but usage is a little different.

config INITRAMFS_BUSYBOX_RUNCON
	bool "runcon"
	default n
	depends on INITRAMFS_BUSYBOX_SELINUX
	help
	  Enable support to run command in speficied security context.

config INITRAMFS_BUSYBOX_FEATURE_RUNCON_LONG_OPTIONS
	bool "Enable long options"
	default y
	depends on INITRAMFS_BUSYBOX_RUNCON && INITRAMFS_BUSYBOX_LONG_OPTS
	help
	  Support long options for the runcon applet.

config INITRAMFS_BUSYBOX_SELINUXENABLED
	bool "selinuxenabled"
	default n
	depends on INITRAMFS_BUSYBOX_SELINUX
	help
	  Enable support for this command to be used within shell scripts
	  to determine if selinux is enabled.

config INITRAMFS_BUSYBOX_SETENFORCE
	bool "setenforce"
	default n
	depends on INITRAMFS_BUSYBOX_SELINUX
	help
	  Enable support to modify the mode SELinux is running in.

config INITRAMFS_BUSYBOX_SETFILES
	bool "setfiles"
	default n
	depends on INITRAMFS_BUSYBOX_SELINUX
	help
	  Enable support to modify to relabel files.
	  Notice: If you built libselinux with -D_FILE_OFFSET_BITS=64,
	  (It is default in libselinux's Makefile), you _must_ enable
	  CONFIG_LFS.

config INITRAMFS_BUSYBOX_FEATURE_SETFILES_CHECK_OPTION
	bool "Enable check option"
	default n
	depends on INITRAMFS_BUSYBOX_SETFILES
	help
	  Support "-c" option (check the validity of the contexts against
	  the specified binary policy) for setfiles. Requires libsepol.

config INITRAMFS_BUSYBOX_SETSEBOOL
	bool "setsebool"
	default n
	depends on INITRAMFS_BUSYBOX_SELINUX
	help
	  Enable support for change boolean.
	  semanage and -P option is not supported yet.

config INITRAMFS_BUSYBOX_SESTATUS
	bool "sestatus"
	default n
	depends on INITRAMFS_BUSYBOX_SELINUX
	help
	  Displays the status of SELinux.

endmenu
```

## config/packages/Kconfig
```kconfig
menu "select optional packages      "

source "generated/ptx_sub_selection.in"

endmenu
```

## config/rtai-3.1-test4/rtai-core/arch/mips/Kconfig
```kconfig
# mainmenu "RTAI/MIPS configuration"

config RTAICFG_MODULES
	bool
	default y

config RTAICFG_RTAI_VERSION
	string
	default "3.1-test4 (vesuvio)"

menu "General"

config RTAICFG_RTAI_INSTALLDIR

default "@BUILDDIR@/rtai-build"

	help
	This option defines the directory where the various RTAI
	files will be installed on your target system.

	This directory may be changed if you double-click in the area
	named "Value". The default installation directory is
	/usr/realtime.

config RTAICFG_RTAI_LINUXDIR

default "@KERNEL_DIR@"

menu "RTAI Documentation"

config RTAICFG_RTAI_DOX_DOC
	bool "Build RTAI Doxygen documentation (HTML)"
	default n
	help
	This option causes the Doxygen-based RTAI documentation to be
	built. This option is intended for people actually writing
	documentation and who want to update the pre-built manuals,
	regular users can just use the latter directly. You will need
	the Doxygen toolsuite for regenerating the documentation.

config RTAICFG_RTAI_DOC_LATEX_NONSTOP
        bool "Enable LaTeX verbose output"
        default n
        help
        By default, all documentation generated with LaTeX uses the 
        silent (batchmode) of LaTeX. If this option is enabled, the 
        verbose (nonstopmode) of LaTeX will be used instead. This 
        option is mainly intended for people writing RTAI 
        documentation.

config RTAICFG_RTAI_DBX_DOC
	bool "Build DocBook XML documentation (HTML/PDF)"
	default n
	help
	This option causes the DocBook XML based RTAI documentation to be
	built. This option is intended for people actually writing
	documentation and who want to update the pre-built manuals,
	regular users can just use the latter directly.

config RTAICFG_RTAI_DBX_NET
        bool "Let the DocBook XML tools use network"
	depends on RTAICFG_RTAI_DBX_DOC
        default n
        help
        Let the DocBook tools use internet to fetch the DTD and XSL stylesheets.
        If disabled, the documentation generation will fail if the necessary 
        DTD(s) and XSL stylesheets can not be found on the local computer.

config RTAICFG_RTAI_DBX_ROOT
        string "Docbook XML root"
	depends on RTAICFG_RTAI_DBX_DOC
        default ""
        help
        Specify the DocBook XML root (that is, the directory where docbook.dtd
        should be taken). Leave blank to let configure try the "well-known"
        locations.

config RTAICFG_RTAI_DBX_XSL_ROOT
        string "Docbook XML XSL stylesheet root"
	depends on RTAICFG_RTAI_DBX_DOC
        default ""
        help
        Specify the DocBook XML XSL root. Leave blank to let configure try the
        "well-known" locations.

endmenu

config RTAICFG_RTAI_TESTSUITE
	bool "Build RTAI testsuite"
	default y
	help
	Once you are done with the building process of RTAI, it may be
	safe to run the testsuite to make sure your RTAI system is
	functional.

config RTAICFG_RTAI_COMPAT
	bool "Enable source compatibility mode"
	default y

config RTAICFG_RTAI_EXTENDED
	bool "Enable extended configuration mode"
	default n

config RTAICFG_RTAI_KMOD_DEBUG
	bool "Enable debug symbols in modules"
	depends on RTAICFG_RTAI_EXTENDED
	default n
	help
	This options adds the -g flag when compiling
	kernel modules.

config RTAICFG_RTAI_USER_DEBUG
	bool "Enable debug symbols in user-space programs"
	depends on RTAICFG_RTAI_EXTENDED
	default n
	help

	This options adds the -g flag when compiling user-space
	programs. LXRT inlining is also implicitely disabled.

config RTAICFG_RTAI_MAINTAINER
	bool "Enable maintainer mode"
	depends on RTAICFG_RTAI_EXTENDED
	default n

config RTAICFG_RTAI_MAINTAINER_AUTOTOOLS
	bool "Enable Autoconf/Automake maintainer mode"
	depends on RTAICFG_RTAI_MAINTAINER
	default n

endmenu

menu "Machine (MIPS)"

config RTAICFG_RTAI_FPU_SUPPORT
	bool
	default n

config RTAICFG_RTAI_CPUS
	string
	default 1

endmenu

menu "Core system"

menu "Schedulers"

config RTAICFG_RTAI_SCHED_UP
	bool "Scheduler for uniprocessor machine (kernel tasks only)"
	default y

config RTAICFG_RTAI_SCHED_SMP
	bool
	default n

config RTAICFG_RTAI_SCHED_MUP
	bool
	default n

config RTAICFG_RTAI_SCHED_LXRT
	bool
	default n

menu "Scheduler options"

	depends on RTAICFG_RTAI_EXTENDED

config RTAICFG_RTAI_SCHED_ISR_LOCK
	bool "Disable rescheduling from ISRs"
	default n

endmenu

endmenu

menu "Basic features"

menu "IPC support"

config RTAICFG_RTAI_BITS
	tristate "Event flags"
	default m

config RTAICFG_RTAI_FIFOS
	tristate "Fifo"
	default m

config RTAICFG_RTAI_NETRPC
	tristate
	default n

config RTAICFG_RTAI_NETRPC_RTNET
	bool "Emulate RTNet"
	depends on RTAICFG_RTAI_NETRPC
	default y

config RTAICFG_RTAI_SHM
	tristate
	default n

config RTAICFG_RTAI_SEM
	tristate "Semaphores"
	default m

config RTAICFG_RTAI_MSG
	tristate "Message"
	default m

config RTAICFG_RTAI_MBX
	tristate "Mailboxes"
	depends on RTAICFG_RTAI_SEM
	default y if RTAICFG_RTAI_SEM=y
	default m if RTAICFG_RTAI_SEM=m

config RTAICFG_RTAI_TBX
	tristate "Typed mailboxes"
	depends on RTAICFG_RTAI_SEM
	default y if RTAICFG_RTAI_SEM=y
	default m if RTAICFG_RTAI_SEM=m

config RTAICFG_RTAI_MQ
	tristate "POSIX-like message queues"
	depends on RTAICFG_RTAI_SEM
	default y if RTAICFG_RTAI_SEM=y
	default m if RTAICFG_RTAI_SEM=m

endmenu

menu "Misc"

config RTAICFG_RTAI_MATH
	bool "Math support"
	depends on RTAICFG_RTAI_FPU_SUPPORT	
	default y

config RTAICFG_RTAI_MATH_C99
	bool "C99 standard support"
	depends on RTAICFG_RTAI_MATH
	default n

config RTAICFG_RTAI_MALLOC
	tristate "Real-time malloc support"
	default y

config RTAICFG_RTAI_MALLOC_VMALLOC
	bool "Use vmalloc() support"
	depends on RTAICFG_RTAI_EXTENDED && RTAICFG_RTAI_MALLOC
	default n

config RTAICFG_RTAI_MALLOC_HEAPSZ
	string "Size of the global heap (Kbytes)"
	depends on RTAICFG_RTAI_MALLOC
	default 128
	help
	RTAI pre-allocates a global heap as part of its initialization
	chores. This parameter allows to define its size (in
	kilobytes).

config RTAICFG_RTAI_TASKLETS
	tristate "Tasklets"
	default m

config RTAICFG_RTAI_TRACE
	bool "LTT support"
	default n

config RTAICFG_RTAI_USI
	tristate "User-space interrupts"
	depends on RTAICFG_RTAI_SEM && RTAICFG_RTAI_TASKLETS
	default y if RTAICFG_RTAI_SEM=y || RTAICFG_RTAI_TASKLETS=y
	default m if RTAICFG_RTAI_SEM=m || RTAICFG_RTAI_TASKLETS=m

config RTAICFG_RTAI_WD
	bool "Watchdog support"
	default y

endmenu

endmenu

endmenu

menu "Add-ons"

config RTAICFG_RTAI_CPLUSPLUS
	bool
	default n

config RTAICFG_RTAI_SERIAL
	bool
	default n

endmenu
```

## config/rtai-3.1-test4/rtai-sim/Kconfig
```kconfig
menu "RTAI Simulator"

config RTAICFG_RTAI_MVM
	bool "Minute Virtual Machine"
	default n
	help

	RTAI includes a Minute Virtual Machine (MVM) associated to the
	Xenomai sub-system.

	Using the MVM to run your real-time applications has a lot of
	advantages: it is faster, it does not require
	cross-development tools, gives extended debugging, monitoring
	and tracing features and provides an easy way to stress the
	application under test with run-time situations otherwise
	barely conceivable on a real target (e.g. bursts of simulated
	interrupts generated at a very unreasonable rate!).

	The application shall not contain target-dependent code, such
	as assembly code, because it runs as a regular executable
	compiled by GCC on a GNU/Linux workstation. It cannot be
	possible to use the MVM to collect accurate performance
	footprints of your system, but it may show you precisely how
	the multiple threads running in your system work together
	sharing the resources of the real-time interface.

config RTAICFG_RTAI_MVM_GCC_TARBALL
	string "GCC tarball"
	depends on RTAICFG_RTAI_MVM
	default "/tmp/gcc-2.95.3.tar.bz2"
	help
	
	In order to be able to instrument your code and debug it using
	the Minute Virtual Machine (MVM), you need a special compiler
	called gcic. This particular tool is based on a patched gcc
	whose archive directory has to be specified here.
	The default value is /tmp/gcc-2.95.3.tar.bz2.

config RTAICFG_RTAI_MVM_DEBUG
	bool "MVM debug support"
	depends on RTAICFG_RTAI_MVM && RTAICFG_RTAI_EXTENDED
	default n
	help
	
	This option activates runtime checking of the event-driven
	simulator state. Do not activate it unless you really intend
	to debug the Minute Virtual Machine.

endmenu
```
