## config/busybox/selinux/Config.in
```kconfig
#
# For a description of the syntax of this configuration file,
# see scripts/kbuild/config-language.txt.
#

menu "Selinux Utilities"
	depends on BUSYBOX
	depends on BB_CONFIG_SELINUX

config BB_CONFIG_CHCON
	bool "chcon"
	default n
	depends on BB_CONFIG_SELINUX
	help
	  Enable support to change the security context of file.

config BB_CONFIG_FEATURE_CHCON_LONG_OPTIONS
	bool "Enable long options"
	default y
	depends on BB_CONFIG_CHCON && BB_CONFIG_GETOPT_LONG
	help
	  Support long options for the chcon applet.

config BB_CONFIG_GETENFORCE
	bool "getenforce"
	default n
	depends on BB_CONFIG_SELINUX
	help
	  Enable support to get the current mode of SELinux.

config BB_CONFIG_GETSEBOOL
	bool "getsebool"
	default n
	depends on BB_CONFIG_SELINUX
	help
	  Enable support to get SELinux boolean values.

config BB_CONFIG_LOAD_POLICY
	bool "load_policy"
	default n
	depends on BB_CONFIG_SELINUX
	help
	  Enable support to load SELinux policy.

config BB_CONFIG_MATCHPATHCON
	bool "matchpathcon"
	default n
	depends on BB_CONFIG_SELINUX
	help
	  Enable support to get default security context of the
	  specified path from the file contexts configuration.

config BB_CONFIG_RESTORECON
	bool "restorecon"
	default n
	depends on BB_CONFIG_SELINUX
	help
	  Enable support to relabel files. The feature is almost
	  the same as setfiles, but usage is a little different.

config BB_CONFIG_RUNCON
	bool "runcon"
	default n
	depends on BB_CONFIG_SELINUX
	help
	  Enable support to run command in speficied security context.

config BB_CONFIG_FEATURE_RUNCON_LONG_OPTIONS
	bool "Enable long options"
	default y
	depends on BB_CONFIG_RUNCON && BB_CONFIG_GETOPT_LONG
	help
	  Support long options for the runcon applet.

config BB_CONFIG_SELINUXENABLED
	bool "selinuxenabled"
	default n
	depends on BB_CONFIG_SELINUX
	help
	  Enable support for this command to be used within shell scripts
	  to determine if selinux is enabled.

config BB_CONFIG_SETENFORCE
	bool "setenforce"
	default n
	depends on BB_CONFIG_SELINUX
	help
	  Enable support to modify the mode SELinux is running in.

config BB_CONFIG_SETFILES
	bool "setfiles"
	default n
	depends on BB_CONFIG_SELINUX
	help
	  Enable support to modify to relabel files.
	  Notice: If you built libselinux with -D_FILE_OFFSET_BITS=64,
	  (It is default in libselinux's Makefile), you _must_ enable
	  CONFIG_LFS.

config BB_CONFIG_FEATURE_SETFILES_CHECK_OPTION
	bool "Enable check option"
	default n
	depends on BB_CONFIG_SETFILES
	help
	  Support "-c" option (check the validity of the contexts against
	  the specified binary policy) for setfiles. Requires libsepol.

config BB_CONFIG_SETSEBOOL
	bool "setsebool"
	default n
	depends on BB_CONFIG_SELINUX
	help
	  Enable support for change boolean.
	  semanage and -P option is not supported yet.

config BB_CONFIG_SESTATUS
	bool "sestatus"
	default n
	depends on BB_CONFIG_SELINUX
	help
	  Displays the status of SELinux.

endmenu
```

## config/busybox/shell/Config.in
```kconfig
#
# For a description of the syntax of this configuration file,
# see scripts/kbuild/config-language.txt.
#

menu "Another Bourne-like Shell"
	depends on BUSYBOX

choice
	prompt "Choose your default shell"
	default "none"
	help
	  Choose a shell. The ash shell is the most bash compatible
	  and full featured.

config BB_CONFIG_FEATURE_SH_IS_ASH
	bool "ash"

config BB_CONFIG_FEATURE_SH_IS_HUSH
	bool "hush"

config BB_CONFIG_FEATURE_SH_IS_LASH
	bool "lash"

config BB_CONFIG_FEATURE_SH_IS_MSH
	bool "msh"

config BB_CONFIG_FEATURE_SH_IS_NONE
	bool "none"

endchoice

if BB_CONFIG_FEATURE_SH_IS_ASH
	config BB_CONFIG_ASH
	default y

	comment "ash (forced enabled as default shell)"
endif
	
if !BB_CONFIG_FEATURE_SH_IS_ASH
config BB_CONFIG_ASH
	bool "ash"
	default y
	help
	  Make sh a link to ash.
endif

comment "Ash Shell Options"
	depends on BB_CONFIG_ASH

config BB_CONFIG_ASH_JOB_CONTROL
	bool "  Enable Job control"
	default y
	depends on BB_CONFIG_ASH
	help
	  Enable job control in the ash shell.

config BB_CONFIG_ASH_ALIAS
	bool "  Enable alias support"
	default y
	depends on BB_CONFIG_ASH
	help
	  Enable alias support in the ash shell.

config BB_CONFIG_ASH_MATH_SUPPORT
	bool "  Enable Posix math support"
	default y
	depends on BB_CONFIG_ASH
	help
	  Enable math support in the ash shell.

config BB_CONFIG_ASH_GETOPTS
	bool "  Enable getopt builtin to parse positional parameters"
	default n
	depends on BB_CONFIG_ASH
	help
	  Enable builtin getopt in the ash shell.

config BB_CONFIG_ASH_CMDCMD
	bool "  Enable cmdcmd to override shell builtins"
	default n
	depends on BB_CONFIG_ASH
	help
	  Enable support for the ash 'command' builtin, which allows
	  you to run the specified command with the specified arguments,
	  even when there is an ash builtin command with the same name.

config BB_CONFIG_ASH_MAIL
	bool "  Check for new mail on interactive shells"
	default y
	depends on BB_CONFIG_ASH
	help
	  Enable "check for new mail" in the ash shell.

config BB_CONFIG_ASH_OPTIMIZE_FOR_SIZE
	bool "  Optimize for size instead of speed"
	default y
	depends on BB_CONFIG_ASH
	help
	  Compile ash for reduced size at price of speed.

if BB_CONFIG_FEATURE_SH_IS_HUSH
	config BB_CONFIG_HUSH
	default y

	comment "hush (forced enabled as default shell)"
endif
	
if !BB_CONFIG_FEATURE_SH_IS_HUSH
config BB_CONFIG_HUSH
	bool "hush"
	default n
	help
	  Make sh a link to hush.
endif

if BB_CONFIG_FEATURE_SH_IS_LASH
	config BB_CONFIG_LASH
	default y

	comment "lash (forced enabled as default shell)"
endif

if !BB_CONFIG_FEATURE_SH_IS_LASH
config BB_CONFIG_LASH
	bool "lash"
	default n
	help
	  Make sh a link to lash.
endif

if BB_CONFIG_FEATURE_SH_IS_MSH
	config BB_CONFIG_MSH
	default y

	comment "msh (forced enabled as default shell)"
endif

if !BB_CONFIG_FEATURE_SH_IS_MSH
config BB_CONFIG_MSH
	bool "msh"
	default n
	help
	  Make sh a link to msh.
endif


comment "Bourne Shell Options"
	depends on BB_CONFIG_MSH || BB_CONFIG_LASH || BB_CONFIG_HUSH || BB_CONFIG_ASH

config BB_CONFIG_FEATURE_COMMAND_EDITING
	bool "command line editing"
	default n
	depends on BB_CONFIG_MSH || BB_CONFIG_LASH || BB_CONFIG_HUSH || BB_CONFIG_ASH
	help
	  Enable command editing in shell.

config BB_CONFIG_FEATURE_COMMAND_SAVEHISTORY
	bool "  history saving"
	default n
	depends on BB_CONFIG_ASH
	help
	  Enable history saving in ash shell.

config BB_CONFIG_FEATURE_COMMAND_TAB_COMPLETION
	bool "tab completion"
	default n
	depends on BB_CONFIG_MSH || BB_CONFIG_LASH || BB_CONFIG_HUSH || BB_CONFIG_ASH
	help
	  Enable tab completion in shell.

config BB_CONFIG_FEATURE_COMMAND_USERNAME_COMPLETION
	bool "username completion"
	default n
	depends on BB_CONFIG_MSH || BB_CONFIG_LASH || BB_CONFIG_HUSH || BB_CONFIG_ASH
	help
	  Enable username completion in shell.

config BB_CONFIG_FEATURE_COMMAND_HISTORY
	int "history size"
	default 15
	depends on BB_CONFIG_MSH || BB_CONFIG_LASH || BB_CONFIG_HUSH || BB_CONFIG_ASH
	help
	  Specify command history size in shell.

config BB_CONFIG_FEATURE_SH_STANDALONE_SHELL
	bool "Standalone shell"
	default n
	depends on BB_CONFIG_MSH || BB_CONFIG_LASH || BB_CONFIG_HUSH || BB_CONFIG_ASH
	help
	  Have all the busybox commands built into the shell, creating
	  a standalone shell.

config BB_CONFIG_FEATURE_SH_APPLETS_ALWAYS_WIN
	bool "Standalone shell -- applets always win"
	default n
	depends on BB_CONFIG_MSH || BB_CONFIG_LASH || BB_CONFIG_HUSH || BB_CONFIG_ASH
	help
	  Use a command builtin to the shell over one with the same name,
	  that may be on the system.

config BB_CONFIG_FEATURE_SH_FANCY_PROMPT
	bool "Fancy shell prompts"
	default n
	depends on BB_CONFIG_MSH || BB_CONFIG_LASH || BB_CONFIG_HUSH || BB_CONFIG_ASH
	help
	  Setting this option allows for prompts to use things like \w and
	  \$ and also using escape codes.

config BB_CONFIG_FEATURE_SH_EXTRA_QUIET
	bool "Hide message on interactive shell startup"
	default n
	depends on BB_CONFIG_MSH || BB_CONFIG_LASH || BB_CONFIG_HUSH || BB_CONFIG_ASH
	help
	  Remove the busybox introduction when starting a shell.

endmenu
```

## config/busybox/shellutils/Config.in
```kconfig
#
# For a description of the syntax of this configuration file,
# see scripts/kbuild/config-language.txt.
#

menu "Shell Utilities"
	depends on BUSYBOX

config BB_CONFIG_BASENAME
	bool "basename"
	default n
	help
	  Please submit a patch to add help text for this item.

config BB_CONFIG_CAL
	bool "cal"
	default n
	help
	  Please submit a patch to add help text for this item.

config BB_CONFIG_CHROOT
	bool "chroot"
	default n
	help
	  Please submit a patch to add help text for this item.

if BB_CONFIG_WATCH
	config BB_CONFIG_DATE
		default y
	comment "date (forced enabled for use with watch)"
endif

if !BB_CONFIG_WATCH
    config BB_CONFIG_DATE
	    bool "date"
	    default n
	    help
	      Please submit a patch to add help text for this item.
endif

config BB_CONFIG_FEATURE_DATE_ISOFMT
	bool "  Enable ISO date format output (-I)"
	default y
	depends on BB_CONFIG_DATE
	help
	  Please submit a patch to add help text for this item.

config BB_CONFIG_DIRNAME
	bool "dirname"
	default n
	help
	  Please submit a patch to add help text for this item.

config BB_CONFIG_ECHO
	bool "echo"
	default n
	help
	  Please submit a patch to add help text for this item.

config BB_CONFIG_ENV
	bool "env"
	default n
	help
	  Please submit a patch to add help text for this item.

config BB_CONFIG_EXPR
	bool "expr"
	default n
	help
	  Please submit a patch to add help text for this item.

if BB_CONFIG_HUSH || BB_CONFIG_LASH || BB_CONFIG_MSH
	config BB_CONFIG_FALSE
		default y
	comment "false (forced enabled for use with shell)"
endif

if !BB_CONFIG_HUSH && !BB_CONFIG_LASH && !BB_CONFIG_MSH
    config BB_CONFIG_FALSE
	    bool "false"
	    default n
	    help
	      Please submit a patch to add help text for this item.
endif

config BB_CONFIG_HOSTID
	bool "hostid"
	default n
	help
	  Please submit a patch to add help text for this item.

config BB_CONFIG_ID
	bool "id"
	default n
	help
	  Please submit a patch to add help text for this item.

config BB_CONFIG_LOGNAME
	bool "logname"
	default n
	help
	  Please submit a patch to add help text for this item.

config BB_CONFIG_PRINTF
	bool "printf"
	default n
	help
	  Please submit a patch to add help text for this item.

config BB_CONFIG_PWD
	bool "pwd"
	default n
	help
	  Please submit a patch to add help text for this item.

config BB_CONFIG_REALPATH
	bool "realpath"
	default n
	help
	  Return the canonicalized absolute pathname.
	  This isnt provided by GNU shellutils, but where else does it belong.

config BB_CONFIG_SLEEP
	bool "sleep"
	default n
	help
	  Please submit a patch to add help text for this item.

config BB_CONFIG_STTY
	bool "stty"
	default n
	help
	  Please submit a patch to add help text for this item.

config BB_CONFIG_TEE
	bool "tee"
	default n
	help
	  Please submit a patch to add help text for this item.

if BB_CONFIG_HUSH || BB_CONFIG_LASH || BB_CONFIG_MSH
	config BB_CONFIG_TRUE
		default y
	comment "true (forced enabled for use with shell)"
endif

if !BB_CONFIG_HUSH && !BB_CONFIG_LASH && !BB_CONFIG_MSH
    config BB_CONFIG_TRUE
	    bool "true"
	    default n
	    help
	      Please submit a patch to add help text for this item.
endif

if BB_CONFIG_ASH || BB_CONFIG_HUSH || BB_CONFIG_LASH || BB_CONFIG_MSH
	config BB_CONFIG_TEST
		default y
	comment "test (forced enabled for use with shell)"
endif

if !BB_CONFIG_ASH && !BB_CONFIG_HUSH && !BB_CONFIG_LASH && !BB_CONFIG_MSH
    config BB_CONFIG_TEST
	    bool "test"
	    default n
	    help
	      Please submit a patch to add help text for this item.
endif

config BB_CONFIG_TTY
	bool "tty"
	default n
	help
	  Please submit a patch to add help text for this item.

config BB_CONFIG_UNAME
	bool "uname"
	default n
	help
	  Please submit a patch to add help text for this item.

config BB_CONFIG_USLEEP
	bool "usleep"
	default n
	help
	  Please submit a patch to add help text for this item.

config BB_CONFIG_WATCH
	bool "watch"
	default n
	help
	  Please submit a patch to add help text for this item.

config BB_CONFIG_WHO
	bool "who"
	default n
	help
	  Please submit a patch to add help text for this item.

config BB_CONFIG_WHOAMI
	bool "whoami"
	default n
	help
	  Please submit a patch to add help text for this item.

config BB_CONFIG_YES
	bool "yes"
	default n
	help
	  Please submit a patch to add help text for this item.

endmenu
```

## config/busybox/textutils/Config.in
```kconfig
#
# For a description of the syntax of this configuration file,
# see scripts/kbuild/config-language.txt.
#

menu "Text Utilities"
	depends on BUSYBOX

config BB_CONFIG_CAT
	bool "cat"
	default n
	help
	  Please submit a patch to add help text for this item.

config BB_CONFIG_CMP
	bool "cmp"
	default n
	help
	  Please submit a patch to add help text for this item.

config BB_CONFIG_CUT
	bool "cut"
	default n
	help
	  Please submit a patch to add help text for this item.

config BB_CONFIG_DOS2UNIX
	bool "dos2unix/unix2dos"
	default n
	help
	  Please submit a patch to add help text for this item.

config BB_CONFIG_HEAD
	bool "head"
	default n
	help
	  Please submit a patch to add help text for this item.

config BB_CONFIG_LENGTH
	bool "length"
	default n
	help
	  Please submit a patch to add help text for this item.

config BB_CONFIG_MD5SUM
	bool "md5sum"
	default n
	help
	  Please submit a patch to add help text for this item.

config BB_CONFIG_OD
	bool "od"
	default n
	help
	  Please submit a patch to add help text for this item.

config BB_CONFIG_SORT
	bool "sort"
	default n
	help
	  Please submit a patch to add help text for this item.

config BB_CONFIG_FEATURE_SORT_REVERSE
	bool "  Enable reverse sort"
	default y
	depends on BB_CONFIG_SORT
	help
	  Please submit a patch to add help text for this item.

config BB_CONFIG_FEATURE_SORT_UNIQUE
	bool "  Enable unique sort"
	default y
	depends on BB_CONFIG_SORT
	help
	  Please submit a patch to add help text for this item.

config BB_CONFIG_TAIL
	bool "tail"
	default n
	help
	  Please submit a patch to add help text for this item.

config BB_CONFIG_FEATURE_FANCY_TAIL
	bool "  Enable extra tail options (-c, -q, -s, and -v)"
	default y
	depends on BB_CONFIG_TAIL
	help
	  Please submit a patch to add help text for this item.

config BB_CONFIG_TR
	bool "tr"
	default n
	help
	  Please submit a patch to add help text for this item.

config BB_CONFIG_UNIQ
	bool "uniq"
	default n
	help
	  Please submit a patch to add help text for this item.

config BB_CONFIG_UUDECODE
	bool "uudecode"
	default n
	help
	  Please submit a patch to add help text for this item.

config BB_CONFIG_UUENCODE
	bool "uuencode"
	default n
	help
	  Please submit a patch to add help text for this item.

config BB_CONFIG_WC
	bool "wc"
	default n
	help
	  Please submit a patch to add help text for this item.

endmenu
```

## config/collection/Kconfig
```kconfig
mainmenu "PTXdist $COLLECTION_VERSION_DEFAULT"

config COLLECTION_VERSION_DEFAULT
	string
	option env="PTXDIST_VERSION_FULL"

config _collectionconfig_MAGIC__
	bool
	default y

choice
	prompt "select packages"
	default COLLECTION_MANUAL

config COLLECTION_NONE
	tristate
	prompt "none  "

config COLLECTION_MANUAL
	tristate
	prompt "manual"

config COLLECTION_ALL
	tristate
	prompt "all   "

endchoice

source "generated/ptx_collection.in"
```
