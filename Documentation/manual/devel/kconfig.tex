## config/busybox/loginutils/Config.in
```kconfig
#
# For a description of the syntax of this configuration file,
# see scripts/kbuild/config-language.txt.
#

menu "Login/Password Management Utilities"
	depends on BUSYBOX

config BB_CONFIG_USE_BB_PWD_GRP
	bool "Use internal password and group functions rather than system functions"
	default n
	help
	  Please submit a patch to add help text for this item.

config BB_CONFIG_ADDGROUP
	bool "addgroup"
	default n
	help
	  Please submit a patch to add help text for this item.

config BB_CONFIG_DELGROUP
	bool "delgroup"
	default n
	help
	  Please submit a patch to add help text for this item.

config BB_CONFIG_ADDUSER
	bool "adduser"
	default n
	help
	  Please submit a patch to add help text for this item.

config BB_CONFIG_DELUSER
	bool "deluser"
	default n
	help
	  Please submit a patch to add help text for this item.

config BB_CONFIG_GETTY
	bool "getty"
	default n
	help
	  Please submit a patch to add help text for this item.

config BB_CONFIG_LOGIN
	bool "login"
	default n
	help
	  Please submit a patch to add help text for this item.

config BB_CONFIG_FEATURE_SECURETTY
	bool "  Support for /etc/securetty"
	default y
	depends on BB_CONFIG_LOGIN
	help
	  Please submit a patch to add help text for this item.

config BB_CONFIG_PASSWD
	bool "passwd"
	default n
	help
	  Please submit a patch to add help text for this item.

config BB_CONFIG_SU
	bool "su"
	default n
	help
	  Please submit a patch to add help text for this item.

config BB_CONFIG_SULOGIN
	bool "sulogin"
	default n
	help
	  Please submit a patch to add help text for this item.

config BB_CONFIG_VLOCK
	bool "vlock"
	default n
	help
	  Please submit a patch to add help text for this item.

comment "Common options for adduser, deluser, login, su"
	depends on BB_CONFIG_ADDUSER || BB_CONFIG_DELUSER || BB_CONFIG_LOGIN || BB_CONFIG_SU

config BB_CONFIG_FEATURE_SHADOWPASSWDS
	bool "Support for shadow passwords"
	default n
	depends on BB_CONFIG_ADDUSER || BB_CONFIG_DELUSER || BB_CONFIG_LOGIN || BB_CONFIG_SU
	help
	  Please submit a patch to add help text for this item.

config BB_CONFIG_USE_BB_SHADOW
	bool "  Use busybox shadow password functions"
	default n
	depends on BB_CONFIG_USE_BB_PWD_GRP && BB_CONFIG_FEATURE_SHADOWPASSWDS
	help
	  Please submit a patch to add help text for this item.

endmenu
```

## config/busybox/miscutils/Config.in
```kconfig
#
# For a description of the syntax of this configuration file,
# see scripts/kbuild/config-language.txt.
#

menu "Miscellaneous Utilities"
	depends on BUSYBOX

config BB_CONFIG_ADJTIMEX
	bool "adjtimex"
	default n
	help
	  Please submit a patch to add help text for this item.

config BB_CONFIG_CROND
	bool "crond"
	default n
	help
	  Please submit a patch to add help text for this item.

config BB_CONFIG_CRONTAB
	bool "crontab"
	default n
	help
	  Please submit a patch to add help text for this item.

config BB_CONFIG_DC
	bool "dc"
	default n
	help
	  Please submit a patch to add help text for this item.

config BB_CONFIG_DUTMP
	bool "dutmp"
	default n
	help
	  Please submit a patch to add help text for this item.

config BB_CONFIG_MAKEDEVS
	bool "makedevs"
	default n
	help
	  Please submit a patch to add help text for this item.

config BB_CONFIG_MT
	bool "mt"
	default n
	help
	  Please submit a patch to add help text for this item.

config BB_CONFIG_STRINGS
	bool "strings"
	default n
	help
	  Please submit a patch to add help text for this item.

config BB_CONFIG_TIME
	bool "time"
	default n
	help
	  Please submit a patch to add help text for this item.

config BB_CONFIG_UPDATE
	bool "update"
	default n
	help
	  Please submit a patch to add help text for this item.

config BB_CONFIG_WATCHDOG
	bool "watchdog"
	default n
	help
	  Please submit a patch to add help text for this item.

endmenu
```
