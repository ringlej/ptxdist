## config/Config.in
```kconfig
#
# config/Config.in: Main menu structure definition
# Copyright (C) Robert Schwebel <r.schwebel@pengutronix.de> 2002, 2003
#

mainmenu "Configuration"

# We need this: otherwhise kconfig doesn't handle tristate entries!!
config MODULES
        bool
        default y

config PTXCONF
	bool
	default y
	help
	  This is the Pengutronix Distribution Build System. A better name
	  for the Projest still has to be found.

config PROJECT
	string
	prompt "Project Name "

############################################################################## 
comment	"General Options ---    "
##############################################################################

source "rules/experimental.in"
source "rules/target.in"
source "rules/cross-toolchain.in"
source "rules/rootfs.in"
source "rules/debug.in"
source "rules/hosttools.in"

##############################################################################
comment "Core System ---    "
##############################################################################

source "rules/kernel.in"
source "rules/libc.in"
source "rules/libcxx.in"

##############################################################################
comment "Core Tools ---  "
##############################################################################

source "rules/bash.in"
source "rules/busybox.in"
source "rules/coreutils.in"
source "rules/gawk.in"
source "rules/hotplug.in"
source "rules/mgetty.in"
source "rules/mtd.in"
source "rules/pcmcia-cs.in"
source "rules/pdksh.in"
source "rules/procps.in"
source "rules/sysutils.in"
source "rules/util-linux.in"
source "rules/vhll.in"

##############################################################################
comment "Network Tools --- "
##############################################################################

menu	"Network Security    "
source "rules/shorewall.in"
source "rules/lsh.in"
source "rules/openssl.in"
source "rules/openssh.in"
source "rules/dropbear.in"
endmenu

menu   "Networking Apps     "
source "rules/betaftpd.in"
source "rules/bind.in"
source "rules/bing.in"
source "rules/dhcp.in"
source "rules/dnsmasq.in"
source "rules/ethereal.in"
source "rules/inetutils.in"
source "rules/libnet.in"
source "rules/libpcap.in"
source "rules/netcat.in"
source "rules/nfs-utils.in"
source "rules/nmap.in"
source "rules/ntp.in"
source "rules/openafs.in"
source "rules/portmap.in"
source "rules/ppp.in"
source "rules/proftpd.in"
source "rules/rsync.in"
source "rules/tcpdump.in"
source "rules/tcpwrapper.in"
source "rules/thttpd.in"
source "rules/utelnetd.in"
source "rules/wireless.in"
source "rules/zebra.in"
endmenu

menu   "Realtime Networking "
source "rules/rtnet.in"
endmenu

############################################################################## 
comment	"Disk and file ---   "
##############################################################################

menu	"Disk and file utils "

source "rules/e2fsprogs.in"
source "rules/grub.in"
source "rules/lilo.in"
source "rules/cramfs.in"
source "rules/bonnie++.in"

endmenu

############################################################################## 
comment	"Applications ---    "
##############################################################################

source "rules/flash.in"
source "rules/kaffe.in"
source "rules/mad.in"
source "rules/setmixer.in"

############################################################################## 

menu "Tools               "

source "rules/tools.in"

endmenu

############################################################################## 

menu "System Libraries    "

source "rules/gettext.in"
source "rules/popt.in"
source "rules/zlib.in"
source "rules/ncurses.in"
source "rules/termcap.in"
source "rules/db41.in"
source "rules/rn.in"
source "rules/libxml2.in"

endmenu

############################################################################## 

menu "Graphics Libraries  "

#source "rules/gtk22.in"
source "rules/xfree430.in"
source "rules/clementine.in"
source "rules/fltk.in"
source "rules/wxWindows.in"
source "rules/qte.in"
source "rules/blackbox.in"

endmenu

############################################################################## 

menu "Scientific Apps     "

source "rules/gnuplot.in"

endmenu

############################################################################## 

menu "Web Applications    "

source "rules/mfirebird.in"
source "rules/penguzilla.in"

endmenu
```

## config/Kconfig
```kconfig
#
# config/Kconfig: Main menu structure definition
# Copyright (C) 2002-2006, 2009 by Robert Schwebel <r.schwebel@pengutronix.de>
#

mainmenu "PTXdist $CONFIGFILE_VERSION"

config MODULES
	bool
	default y

source "generated/project_specific.in"
source "generated/fixme.in"

source "generated/project_name.in"

source "rules/Kconfig"
```

## config/boardsetup/Kconfig
```kconfig
# configuration for board setup

mainmenu "PTXdist $BOARDSETUP_VERSION_DEFAULT"

config BOARDSETUP_VERSION_DEFAULT
	string
	option env="PTXDIST_VERSION_FULL"

menu "Network Configuration         "

config BOARDSETUP_SERVERIP
	string
	prompt "server IP address"
	help
	  Specify your target board's server IP address here.

config BOARDSETUP_TARGETIP
	string
	prompt "target IP address"
	help
	  Specify your target board's IP address here.

config BOARDSETUP_GATEWAY
	string
	prompt "gateway IP"
	help
	  Specify your target board's gateway IP address here.

config BOARDSETUP_NETMASK
	string
	prompt "netmask"
	help
	  Specify your target board's netmask here.

config BOARDSETUP_NFSROOT_PATH
	string
	prompt "nfsroot path"
	default "${PTXDIST_PLATFORMDIR}/root"
	help
	  Specify path where the target should mount its rootpath via nfs. If you
	  have built a BSP, a reasonalbe value for this field might be the path to
	  the root/ directory under the location of your BSP. Ensure that the
	  above given path is exported by nfs server. This field will be ignored
	  if you don't use nfsroot.

config BOARDSETUP_TFTP_PATH
	string
	prompt "tftp path"
	default "/tftpboot"
	help
	  Specify path where the target can fetch files via TFTP. Mostly this is
	  /tftpboot so the default can be used, but it depends on the host
	  distribution. The image file for the rootfs will be copied into this
	  directory prior flashing the target. Ensure write permissions into this
	  directory.

config BOARDSETUP_ETH_INTERFACE
	string
	prompt "ethernet interface (for tap devices only)"
	default "labnet1"
	help
	  If running virtual hardware (simulated by qemu/kvm), qemu needs to know
	  about a tap interface for virtual networking. Specify it here.

endmenu

menu "Host's Serial Configuration   "

config BOARDSETUP_SERIALPORT
	string
	prompt "serial port"
	default "/dev/ttyS0"
	help
	  Specify host's serial port for target connection.
	  You can also use a rfc2217-connection (comport-over-telnet). Simply
	  enter 'host:port'.

config BOARDSETUP_SERIALBAUDRATE
	string
	prompt "serial baud rate"
	default "115200"
	help
	  Specify the serial port's baud rate the target is using here.

endmenu
```

## config/busybox-1.4.1/debianutils/Config.in
```kconfig
#
# For a description of the syntax of this configuration file,
# see scripts/kbuild/config-language.txt.
#

menu "Debian Utilities"
  depends on BUSYBOX

config BB_MKTEMP
	bool "mktemp"
	default n
	help
	  mktemp is used to create unique temporary files

config BB_PIPE_PROGRESS
	bool "pipe_progress"
	default n
	help
	  Display a dot to indicate pipe activity.

config BB_READLINK
	bool "readlink"
	default n
	help
	  This program reads a symbolic link and returns the name
	  of the file it points to

config BB_FEATURE_READLINK_FOLLOW
	bool "Enable canonicalization by following all symlinks (-f)"
	default n
	depends on BB_READLINK
	help
	  Enable the readlink option (-f).

config BB_RUN_PARTS
	bool "run-parts"
	default n
	help
	  run-parts is a utility designed to run all the scripts in a directory.

	  It is useful to set up a directory like cron.daily, where you need to
	  execute all the scripts in that directory.

	  In this implementation of run-parts some features (such as report mode)
	  are not implemented.

	  Unless you know that run-parts is used in some of your scripts
	  you can safely say N here.

config BB_FEATURE_RUN_PARTS_LONG_OPTIONS
	bool "Enable long options"
	default n
	depends on BB_RUN_PARTS && BB_GETOPT_LONG
	help
	  Support long options for the run-parts applet.

config BB_START_STOP_DAEMON
	bool "start-stop-daemon"
	default y
	help
	  start-stop-daemon is used to control the creation and
	  termination of system-level processes, usually the ones
	  started during the startup of the system.

config BB_FEATURE_START_STOP_DAEMON_FANCY
	bool "Support additional arguments"
	default y
	depends on BB_START_STOP_DAEMON
	help
	  Support additional arguments.
	  -o|--oknodo ignored since we exit with 0 anyway
	  -v|--verbose

config BB_FEATURE_START_STOP_DAEMON_LONG_OPTIONS
	bool "Enable long options"
	default n
	depends on BB_START_STOP_DAEMON && BB_GETOPT_LONG
	help
	  Support long options for the start-stop-daemon applet.

config BB_WHICH
	bool "which"
	default n
	help
	  which is used to find programs in your PATH and
	  print out their pathnames.

endmenu
```
