## config/busybox/networking/Config.in
```kconfig
#
# For a description of the syntax of this configuration file,
# see scripts/kbuild/config-language.txt.
#

menu "Networking Utilities"
	depends on BUSYBOX

config BB_CONFIG_FEATURE_IPV6
	bool "Enable IPv6 support"
	default n
	help
	  Please submit a patch to add help text for this item.

config BB_CONFIG_ARPING
	bool "arping"
	default n
	help
	  Ping hosts by ARP packets

config BB_CONFIG_FTPGET
	bool "ftpget"
	default n
	help
	  Retrieve a remote file via FTP.

config BB_CONFIG_FTPPUT
	bool "ftpput"
	default n
	help
	  Store a remote file via FTP.

config BB_CONFIG_HOSTNAME
	bool "hostname"
	default n
	help
	  Please submit a patch to add help text for this item.

config BB_CONFIG_HTTPD
	bool "httpd"
	default n
	help
	  Serve web pages via an HTTP server.

config BB_CONFIG_FEATURE_HTTPD_USAGE_FROM_INETD_ONLY
	bool "  Support call from inetd only"
	default n
	depends on BB_CONFIG_HTTPD
	help
	  This option disabling uid and port options for httpd applet
	  and more others reducing size moments, but require
	  internet superserver daemon for usaging.

config BB_CONFIG_FEATURE_HTTPD_BASIC_AUTH
	bool "  Enable Basic Authentication"
	default n
	depends on BB_CONFIG_HTTPD
	help
	  Utilizes /etc/httpd.conf for basic authentication on a
	  per url basis.

config BB_CONFIG_FEATURE_HTTPD_CGI
	bool "  Enable support Common Gateway Interface"
	default n
	depends on BB_CONFIG_HTTPD
	help
	  Disable this for do very small module

config BB_CONFIG_FEATURE_HTTPD_RELOAD_CONFIG_SIGHUP
	bool "  Enable support reload global config file after hup signaled"
	default n
	depends on BB_CONFIG_HTTPD
	help
	  Disable this for do very small module

config BB_CONFIG_FEATURE_HTTPD_SETUID
	bool "  Enable support -u user option"
	default n
	depends on BB_CONFIG_HTTPD
	help
	  Require for drop privilegies after bind() to privilegies port

config BB_CONFIG_FEATURE_HTTPD_CONFIG_WITH_MIME_TYPES
	bool "  Enable support load from config file mime types"
	default n
	depends on BB_CONFIG_HTTPD
	help
	  After set this you can adding or change mime types from file
	  suffixes in config files

config BB_CONFIG_FEATURE_HTTPD_SET_REMOTE_PORT_TO_ENV
	bool "  Enable support set eviroment REMOTE_PORT"
	default n
	depends on BB_CONFIG_FEATURE_HTTPD_CGI
	help
	  After set this your CGI script can know own remote port connecting

config BB_CONFIG_FEATURE_HTTPD_SET_CGI_VARS_TO_ENV
	bool "  Enable support nonstandart httpd feature set CGI_var=value"
	default n
	depends on BB_CONFIG_FEATURE_HTTPD_CGI
	help
	  After set this your CGI script can have trivial parse getted vars

config BB_CONFIG_FEATURE_HTTPD_DECODE_URL_STR
	bool "  Support nonstandart httpd feature decode URL to stdout"
	default n
	depends on BB_CONFIG_HTTPD
	help
	  After set this your can decode URL from -d argument to stdout,
	  example -d "Hello%20World" as "Hello World"

config BB_CONFIG_FEATURE_HTTPD_ENCODE_URL_STR
	bool "  Support nonstandart httpd feature encode argument to URL"
	default n
	depends on BB_CONFIG_HTTPD
	help
	  After set this your can encode from -d argument to stdout as URL,
	  example -e "<Hello World>" as "%3CHello%20World%3E"


config BB_CONFIG_IFCONFIG
	bool "ifconfig"
	default n
	help
	  Please submit a patch to add help text for this item.

config BB_CONFIG_FEATURE_IFCONFIG_STATUS
	bool "  Enable status reporting output (+7k)"
	default y
	depends on BB_CONFIG_IFCONFIG
	help
	  Please submit a patch to add help text for this item.

config BB_CONFIG_FEATURE_IFCONFIG_SLIP
	bool "  Enable slip-specific options \"keepalive\" and \"outfill\""
	default n
	depends on BB_CONFIG_IFCONFIG
	help
	  Please submit a patch to add help text for this item.

config BB_CONFIG_FEATURE_IFCONFIG_MEMSTART_IOADDR_IRQ
	bool "  Enable options \"mem_start\", \"io_addr\", and \"irq\""
	default n
	depends on BB_CONFIG_IFCONFIG
	help
	  Please submit a patch to add help text for this item.

config BB_CONFIG_FEATURE_IFCONFIG_HW
	bool "  Enable option \"hw\" (ether only)"
	default y
	depends on BB_CONFIG_IFCONFIG
	help
	  Please submit a patch to add help text for this item.

config BB_CONFIG_FEATURE_IFCONFIG_BROADCAST_PLUS
	bool "  Set the broadcast automatically"
	default n
	depends on BB_CONFIG_IFCONFIG
	help
	  Please submit a patch to add help text for this item.

config BB_CONFIG_IFUPDOWN
	bool "ifupdown"
	default n
	help
	  Please submit a patch to add help text for this item.

config BB_CONFIG_FEATURE_IFUPDOWN_IP
	bool "  Use ip applet"
	default n
	depends on BB_CONFIG_IFUPDOWN && BB_CONFIG_IP && BB_CONFIG_FEATURE_IP_ADDRESS && BB_CONFIG_FEATURE_IP_LINK && BB_CONFIG_FEATURE_IP_ROUTE
	help
	  Please submit a patch to add help text for this item.

config BB_CONFIG_FEATURE_IFUPDOWN_IPV4
	bool "  Enable support for IPv4"
	default y
	depends on BB_CONFIG_IFUPDOWN
	help
	  Please submit a patch to add help text for this item.

config BB_CONFIG_FEATURE_IFUPDOWN_IPV6
	bool "  Enable support for IPv6"
	default n
	depends on BB_CONFIG_IFUPDOWN
	help
	  Please submit a patch to add help text for this item.

config BB_CONFIG_FEATURE_IFUPDOWN_IPX
	bool "  Enable support for IPX"
	default n
	depends on BB_CONFIG_IFUPDOWN
	help
	  Please submit a patch to add help text for this item.

config BB_CONFIG_FEATURE_IFUPDOWN_MAPPING
	bool "  Enable mapping support"
	default n
	depends on BB_CONFIG_IFUPDOWN
	help
	  This enables support for the "mapping" stanza, unless you have
	  a weird network setup you dont need it.

config BB_CONFIG_INETD
	bool "inetd"
	default n
	help
	  Internet superserver daemon

config BB_CONFIG_FEATURE_INETD_SUPPORT_BILTIN_ECHO
	bool "  Support echo service"
	default y
	depends on BB_CONFIG_INETD
	help
	  Echo received data internal inetd service

config BB_CONFIG_FEATURE_INETD_SUPPORT_BILTIN_DISCARD
	bool "  Support discard service"
	default y
	depends on BB_CONFIG_INETD
	help
	  Internet /dev/null internal inetd service

config BB_CONFIG_FEATURE_INETD_SUPPORT_BILTIN_TIME
	bool "  Support time service"
	default y
	depends on BB_CONFIG_INETD
	help
	  Return 32 bit time since 1900 internal inetd service

config BB_CONFIG_FEATURE_INETD_SUPPORT_BILTIN_DAYTIME
	bool "  Support daytime service"
	default y
	depends on BB_CONFIG_INETD
	help
	  Return human-readable time internal inetd service

config BB_CONFIG_FEATURE_INETD_SUPPORT_BILTIN_CHARGEN
	bool "  Support chargen service"
	default y
	depends on BB_CONFIG_INETD
	help
	  Familiar character generator internal inetd service


config BB_CONFIG_IP
	bool "ip"
	default n
	help
	  Please submit a patch to add help text for this item.

if BB_CONFIG_IP && BB_CONFIG_IPADDR
	config BB_CONFIG_FEATURE_IP_ADDRESS
		default y
	comment "  address (forced enabled for ipaddr)"
endif
if ! (BB_CONFIG_IP && BB_CONFIG_IPADDR)
	config BB_CONFIG_FEATURE_IP_ADDRESS
		bool "  address"
		default y
		depends on BB_CONFIG_IP
		help
		  Please submit a patch to add help text for this item.
endif

if BB_CONFIG_IP && BB_CONFIG_IPLINK
	config BB_CONFIG_FEATURE_IP_LINK
		default y
	comment "  link (forced enabled for iplink)"
endif
if !(BB_CONFIG_IP && BB_CONFIG_IPLINK)
	config BB_CONFIG_FEATURE_IP_LINK
		bool "  link"
		default y
		depends on BB_CONFIG_IP
		help
		  Please submit a patch to add help text for this item.
endif

if BB_CONFIG_IP && BB_CONFIG_IPROUTE
	config BB_CONFIG_FEATURE_IP_ROUTE
		default y
	comment "  route (forced enabled for iproute)"
endif
if !(BB_CONFIG_IP && BB_CONFIG_IPROUTE)
	config BB_CONFIG_FEATURE_IP_ROUTE
		bool "  route"
		default y
		depends on BB_CONFIG_IP
		help
		  Please submit a patch to add help text for this item.
endif

if BB_CONFIG_IP && BB_CONFIG_IPTUNNEL
	config BB_CONFIG_FEATURE_IP_TUNNEL
		default y
	comment "  tunnel (forced enabled for iptunnel)"
endif
if !(BB_CONFIG_IP && BB_CONFIG_IPTUNNEL)
	config BB_CONFIG_FEATURE_IP_TUNNEL
		bool "  tunnel"
		default n
		depends on BB_CONFIG_IP
		help
		  Please submit a patch to add help text for this item.
endif

config BB_CONFIG_IPCALC
	bool "ipcalc"
	default n
	help
	  Please submit a patch to add help text for this item.

config BB_CONFIG_FEATURE_IPCALC_FANCY
	bool "  Fancy IPCALC, more options, adds 300 bytes"
	default y
	depends on BB_CONFIG_IPCALC
	help
	  Please submit a patch to add help text for this item.

config BB_CONFIG_IPADDR
	bool "ipaddr"
	default n
	help
	  Please submit a patch to add help text for this item.

config BB_CONFIG_IPLINK
	bool "iplink"
	default n
	help
	  Please submit a patch to add help text for this item.

config BB_CONFIG_IPROUTE
	bool "iproute"
	default n
	help
	  Please submit a patch to add help text for this item.

config BB_CONFIG_IPTUNNEL
	bool "iptunnel"
	default n
	help
	  Please submit a patch to add help text for this item.

config BB_CONFIG_NAMEIF
	bool "nameif"
	default n
	help
	  nameif used to rename network interface by its MAC address.
	  Renamed interfaces MUST be in the down state.
	  It is possible to use file (default: /etc/mactab)
	  with list of new interface names and MACs.
	  Maximum interface name length: IF_NAMESIZE = 16
	  File fields are sepatated by space or tab.
	  File format:
	  # Comment
	  new_interface_name	XX:XX:XX:XX:XX:XX

config BB_CONFIG_NC
	bool "nc"
	default n
	help
	  Please submit a patch to add help text for this item.

config BB_CONFIG_NETSTAT
	bool "netstat"
	default n
	help
	  Please submit a patch to add help text for this item.

config BB_CONFIG_NSLOOKUP
	bool "nslookup"
	default n
	help
	  Please submit a patch to add help text for this item.

config BB_CONFIG_PING
	bool "ping"
	default n
	help
	  Please submit a patch to add help text for this item.

config BB_CONFIG_FEATURE_FANCY_PING
	bool "  Enable fancy ping output"
	default y
	depends on BB_CONFIG_PING
	help
	  Please submit a patch to add help text for this item.

config BB_CONFIG_PING6
	bool "ping6"
	default n
	depends on BB_CONFIG_FEATURE_IPV6
	help
	  Please submit a patch to add help text for this item.

config BB_CONFIG_FEATURE_FANCY_PING6
	bool "  Enable fancy ping6 output"
	default y
	depends on BB_CONFIG_PING6
	help
	  Please submit a patch to add help text for this item.

config BB_CONFIG_ROUTE
	bool "route"
	default n
	help
	  Please submit a patch to add help text for this item.

config BB_CONFIG_TELNET
	bool "telnet"
	default n
	help
	  Please submit a patch to add help text for this item.

config BB_CONFIG_FEATURE_TELNET_TTYPE
	bool "  Pass TERM type to remote host"
	default y
	depends on BB_CONFIG_TELNET
	help
	  Please submit a patch to add help text for this item.

config BB_CONFIG_TELNETD
	bool "telnetd"
	default n
	help
	  Please submit a patch to add help text for this item.

config BB_CONFIG_FEATURE_TELNETD_INETD
	bool "  Support call from inetd only"
	default n
	depends on BB_CONFIG_TELNETD
	help
	  Please submit a patch to add help text for this item.

config BB_CONFIG_TFTP
	bool "tftp"
	default n
	help
	  Please submit a patch to add help text for this item.

config BB_CONFIG_FEATURE_TFTP_GET
	bool "  Enable \"get\" command"
	default y
	depends on BB_CONFIG_TFTP
	help
	  Please submit a patch to add help text for this item.

config BB_CONFIG_FEATURE_TFTP_PUT
	bool "  Enable \"put\" command"
	default y
	depends on BB_CONFIG_TFTP
	help
	  Please submit a patch to add help text for this item.

config BB_CONFIG_FEATURE_TFTP_BLOCKSIZE
	bool "  Enable \"blocksize\" command"
	default n
	depends on BB_CONFIG_TFTP
	help
	  Please submit a patch to add help text for this item.

config BB_CONFIG_FEATURE_TFTP_DEBUG
	bool "  Enable debug"
	default y
	depends on BB_CONFIG_TFTP
	help
	  Please submit a patch to add help text for this item.

config BB_CONFIG_TRACEROUTE
	bool "traceroute"
	default n
	help
	  Please submit a patch to add help text for this item.

config BB_CONFIG_FEATURE_TRACEROUTE_VERBOSE
	bool "  Enable verbose output"
	default y
	depends on BB_CONFIG_TRACEROUTE
	help
	  Please submit a patch to add help text for this item.

config BB_CONFIG_FEATURE_TRACEROUTE_SO_DEBUG
	bool "  Enable SO_DEBUG option"
	default y
	depends on BB_CONFIG_TRACEROUTE
	help
	  Please submit a patch to add help text for this item.

config BB_CONFIG_VCONFIG
	bool "vconfig"
	default n
	help
	  Creates, removes, and configures VLAN interfaces

config BB_CONFIG_WGET
	bool "wget"
	default n
	help
	  Please submit a patch to add help text for this item.

config BB_CONFIG_FEATURE_WGET_STATUSBAR
	bool "  Enable a nifty process meter (+2k)"
	default y
	depends on BB_CONFIG_WGET
	help
	  Please submit a patch to add help text for this item.

config BB_CONFIG_FEATURE_WGET_AUTHENTICATION
	bool "  Enable HTTP authentication"
	default y
	depends on BB_CONFIG_WGET
	help
	  Please submit a patch to add help text for this item.

source config/busybox/networking/udhcp/Config.in

endmenu
```

## config/busybox/networking/udhcp/Config.in
```kconfig
#
# For a description of the syntax of this configuration file,
# see scripts/kbuild/config-language.txt.
#

menu "udhcp Server/Client"
	depends on BUSYBOX

config BB_CONFIG_UDHCPD
	bool "udhcp Server (udhcpd)"
	default n
	help
	  Please submit a patch to add help text for this item.

config BB_CONFIG_UDHCPC
	bool "udhcp Client (udhcpc)"
	default n
	help
	  Please submit a patch to add help text for this item.

config BB_CONFIG_DUMPLEASES
	bool "Lease display utility (dumpleases)"
	default n
	depends on BB_CONFIG_UDHCPD
	help
	  Please submit a patch to add help text for this item.

config BB_CONFIG_FEATURE_UDHCP_SYSLOG
	bool "  Log udhcp messages to syslog (instead of stdout)"
	default n
	depends on BB_CONFIG_UDHCPD || BB_CONFIG_UDHCPC
	help
	  Please submit a patch to add help text for this item.

config BB_CONFIG_FEATURE_UDHCP_DEBUG
	bool "  Compile udhcp with noisy debugging messages"
	default n
	depends on BB_CONFIG_UDHCPD || BB_CONFIG_UDHCPC
	help
	  Please submit a patch to add help text for this item.

endmenu
```

## config/busybox/procps/Config.in
```kconfig
#
# For a description of the syntax of this configuration file,
# see scripts/kbuild/config-language.txt.
#

menu "Process Utilities"
	depends on BUSYBOX

config BB_CONFIG_FREE
	bool "free"
	default n
	help
	  free displays the total amount of free and used physical and swap
	  memory in the system, as well as the buffers used by the kernel.
	  The shared memory column should be ignored; it is obsolete.

config BB_CONFIG_KILL
	bool "kill"
	default n
	help
	  The command kill sends the specified signal to the specified
	  process or process group.  If no signal is specified, the TERM
	  signal is sent.

config BB_CONFIG_KILLALL
	bool "killall"
	default n
	depends on BB_CONFIG_KILL
	help
	  killall sends a signal to all processes running any of the
	  specified commands.  If no signal name is specified, SIGTERM is
	  sent.

config BB_CONFIG_PIDOF
	bool "pidof"
	default n
	help
	  Pidof finds the process id's (pids) of the named programs. It prints
	  those id's on the standard output.

config BB_CONFIG_PS
	bool "ps"
	default n
	help
	  ps gives a snapshot of the current processes.

config BB_CONFIG_RENICE
	bool "renice"
	default n
	help
	  Renice alters the scheduling priority of one or more running
	  processes.

config BB_CONFIG_TOP
	bool "top"
	default n
	help
	  The top program provides a dynamic real-time view of a running
	  system.

config BB_FEATURE_CPU_USAGE_PERCENTAGE
	bool "  Support show CPU usage percentage (add 2k bytes)"
	default y
	depends on BB_CONFIG_TOP
	help
	  Make top display CPU usage.

config BB_CONFIG_UPTIME
	bool "uptime"
	default n
	help
	  uptime gives a one line display of the current time, how long
	  the system has been running, how many users are currently logged
	  on, and the system load averages for the past 1, 5, and 15 minutes.

endmenu
```
