## config/busybox/coreutils/Config.in
```kconfig
#
# For a description of the syntax of this configuration file,
# see scripts/kbuild/config-language.txt.
#

menu "Coreutils"
	depends on BUSYBOX

config BB_CONFIG_BASENAME
	bool "basename"
	default n
	help
	  Please submit a patch to add help text for this item.

config BB_CONFIG_CAL
	bool "cal"
	default n
	help
	  Please submit a patch to add help text for this item.

config BB_CONFIG_CAT
	bool "cat"
	default n
	help
	  Please submit a patch to add help text for this item.

config BB_CONFIG_CHGRP
	bool "chgrp"
	default n
	help
	  Please submit a patch to add help text for this item.

config BB_CONFIG_CHMOD
	bool "chmod"
	default n
	help
	  Please submit a patch to add help text for this item.

config BB_CONFIG_CHOWN
	bool "chown"
	default n
	help
	  Please submit a patch to add help text for this item.

config BB_CONFIG_CHROOT
	bool "chroot"
	default n
	help
	  Please submit a patch to add help text for this item.

config BB_CONFIG_CMP
	bool "cmp"
	default n
	help
	  Please submit a patch to add help text for this item.

config BB_CONFIG_CP
	bool "cp"
	default n
	help
	  Please submit a patch to add help text for this item.

config BB_CONFIG_CUT
	bool "cut"
	default n
	help
	  Please submit a patch to add help text for this item.

if BB_CONFIG_WATCH
	config BB_CONFIG_DATE
		default y
	comment "date (forced enabled for use with watch)"
endif

if !BB_CONFIG_WATCH
    config BB_CONFIG_DATE
	    bool "date"
	    default n
	    help
	      Please submit a patch to add help text for this item.
endif

config BB_CONFIG_FEATURE_DATE_ISOFMT
	bool "  Enable ISO date format output (-I)"
	default y
	depends on BB_CONFIG_DATE
	help
	  Please submit a patch to add help text for this item.

config BB_CONFIG_DD
	bool "dd"
	default n
	help
	  Please submit a patch to add help text for this item.

config BB_CONFIG_DF
	bool "df"
	default n
	help
	  Please submit a patch to add help text for this item.

config BB_CONFIG_DIRNAME
	bool "dirname"
	default n
	help
	  Please submit a patch to add help text for this item.

config BB_CONFIG_DOS2UNIX
	bool "dos2unix/unix2dos"
	default n
	help
	  Please submit a patch to add help text for this item.

config BB_CONFIG_DU
	bool "du"
	default n
	help
	  Please submit a patch to add help text for this item.

config BB_CONFIG_ECHO
	bool "echo"
	default n
	help
	  Please submit a patch to add help text for this item.

config BB_CONFIG_ENV
	bool "env"
	default n
	help
	  Please submit a patch to add help text for this item.

config BB_CONFIG_EXPR
	bool "expr"
	default n
	help
	  Please submit a patch to add help text for this item.

if BB_CONFIG_HUSH || BB_CONFIG_LASH || BB_CONFIG_MSH
	config BB_CONFIG_FALSE
		default y
	comment "false (forced enabled for use with shell)"
endif

if !BB_CONFIG_HUSH && !BB_CONFIG_LASH && !BB_CONFIG_MSH
    config BB_CONFIG_FALSE
	    bool "false"
	    default n
	    help
	      Please submit a patch to add help text for this item.
endif

config BB_CONFIG_HEAD
	bool "head"
	default n
	help
	  Please submit a patch to add help text for this item.

config BB_CONFIG_HOSTID
	bool "hostid"
	default n
	help
	  Please submit a patch to add help text for this item.

config BB_CONFIG_ID
	bool "id"
	default n
	help
	  Please submit a patch to add help text for this item.

config BB_CONFIG_LENGTH
	bool "length"
	default n
	help
	  Please submit a patch to add help text for this item.

config BB_CONFIG_LN
	bool "ln"
	default n
	help
	  Please submit a patch to add help text for this item.

config BB_CONFIG_LOGNAME
	bool "logname"
	default n
	help
	  Please submit a patch to add help text for this item.

config BB_CONFIG_LS
	bool "ls"
	default n
	help
	  Please submit a patch to add help text for this item.

config BB_CONFIG_FEATURE_LS_FILETYPES
	bool "  Enable filetyping options (-p and -F)"
	default y
	depends on BB_CONFIG_LS
	help
	  Please submit a patch to add help text for this item.

config BB_CONFIG_FEATURE_LS_FOLLOWLINKS
	bool "  Enable symlinks dereferencing (-L)"
	default y
	depends on BB_CONFIG_LS
	help
	  Please submit a patch to add help text for this item.

config BB_CONFIG_FEATURE_LS_RECURSIVE
	bool "  Enable recursion (-R)"
	default y
	depends on BB_CONFIG_LS
	help
	  Please submit a patch to add help text for this item.

config BB_CONFIG_FEATURE_LS_SORTFILES
	bool "  Sort the file names"
	default y
	depends on BB_CONFIG_LS
	help
	  Please submit a patch to add help text for this item.

config BB_CONFIG_FEATURE_LS_TIMESTAMPS
	bool "  Show file timestamps"
	default y
	depends on BB_CONFIG_LS
	help
	  Please submit a patch to add help text for this item.

config BB_CONFIG_FEATURE_LS_USERNAME
	bool "  Show username/groupnames"
	default y
	depends on BB_CONFIG_LS
	help
	  Please submit a patch to add help text for this item.

config BB_CONFIG_FEATURE_LS_COLOR
	bool "  Use color to identify file types"
	default y
	depends on BB_CONFIG_LS
	help
	  Please submit a patch to add help text for this item.

config BB_CONFIG_MD5SUM
	bool "md5sum"
	default n
	help
	  Please submit a patch to add help text for this item.

config BB_CONFIG_MKDIR
	bool "mkdir"
	default n
	help
	  Please submit a patch to add help text for this item.

config BB_CONFIG_MKFIFO
	bool "mkfifo"
	default n
	help
	  Please submit a patch to add help text for this item.

config BB_CONFIG_MKNOD
	bool "mknod"
	default n
	help
	  Please submit a patch to add help text for this item.

config BB_CONFIG_MV
	bool "mv"
	default n
	help
	  Please submit a patch to add help text for this item.

config BB_CONFIG_OD
	bool "od"
	default n
	help
	  Please submit a patch to add help text for this item.

config BB_CONFIG_PRINTF
	bool "printf"
	default n
	help
	  Please submit a patch to add help text for this item.

config BB_CONFIG_PWD
	bool "pwd"
	default n
	help
	  Please submit a patch to add help text for this item.

config BB_CONFIG_REALPATH
	bool "realpath"
	default n
	help
	  Return the canonicalized absolute pathname.
	  This isnt provided by GNU shellutils, but where else does it belong.

config BB_CONFIG_RM
	bool "rm"
	default n
	help
	  Please submit a patch to add help text for this item.

config BB_CONFIG_RMDIR
	bool "rmdir"
	default n
	help
	  Please submit a patch to add help text for this item.

config BB_CONFIG_SHA1SUM
	bool "sha1sum"
	default n
	help
	  Compute and check SHA1 message digest

config BB_CONFIG_SLEEP
	bool "sleep"
	default n
	help
	  Please submit a patch to add help text for this item.

config BB_CONFIG_SORT
	bool "sort"
	default n
	help
	  Please submit a patch to add help text for this item.

config BB_CONFIG_FEATURE_SORT_REVERSE
	bool "  Enable reverse sort"
	default y
	depends on BB_CONFIG_SORT
	help
	  Please submit a patch to add help text for this item.

config BB_CONFIG_FEATURE_SORT_UNIQUE
	bool "  Enable unique sort"
	default y
	depends on BB_CONFIG_SORT
	help
	  Please submit a patch to add help text for this item.

config BB_CONFIG_STTY
	bool "stty"
	default n
	help
	  Please submit a patch to add help text for this item.

config BB_CONFIG_SYNC
	bool "sync"
	default n
	help
	  Please submit a patch to add help text for this item.

config BB_CONFIG_TAIL
	bool "tail"
	default n
	help
	  Please submit a patch to add help text for this item.

config BB_CONFIG_FEATURE_FANCY_TAIL
	bool "  Enable extra tail options (-c, -q, -s, and -v)"
	default y
	depends on BB_CONFIG_TAIL
	help
	  Please submit a patch to add help text for this item.

config BB_CONFIG_TEE
	bool "tee"
	default n
	help
	  Please submit a patch to add help text for this item.

if BB_CONFIG_ASH || BB_CONFIG_HUSH || BB_CONFIG_LASH || BB_CONFIG_MSH
	config BB_CONFIG_TEST
		default y
	comment "test (forced enabled for use with shell)"
endif

if !BB_CONFIG_ASH && !BB_CONFIG_HUSH && !BB_CONFIG_LASH && !BB_CONFIG_MSH
    config BB_CONFIG_TEST
	    bool "test"
	    default n
	    help
	      Please submit a patch to add help text for this item.
endif

config BB_CONFIG_TOUCH
	bool "touch"
	default n
	help
	  Please submit a patch to add help text for this item.

config BB_CONFIG_TR
	bool "tr"
	default n
	help
	  Please submit a patch to add help text for this item.

if BB_CONFIG_HUSH || BB_CONFIG_LASH || BB_CONFIG_MSH
	config BB_CONFIG_TRUE
		default y
	comment "true (forced enabled for use with shell)"
endif

if !BB_CONFIG_HUSH && !BB_CONFIG_LASH && !BB_CONFIG_MSH
    config BB_CONFIG_TRUE
	    bool "true"
	    default n
	    help
	      Please submit a patch to add help text for this item.
endif

config BB_CONFIG_TTY
	bool "tty"
	default n
	help
	  Please submit a patch to add help text for this item.

config BB_CONFIG_UNAME
	bool "uname"
	default n
	help
	  Please submit a patch to add help text for this item.

config BB_CONFIG_UNIQ
	bool "uniq"
	default n
	help
	  Please submit a patch to add help text for this item.

config BB_CONFIG_USLEEP
	bool "usleep"
	default n
	help
	  Please submit a patch to add help text for this item.

config BB_CONFIG_UUDECODE
	bool "uudecode"
	default n
	help
	  Please submit a patch to add help text for this item.

config BB_CONFIG_UUENCODE
	bool "uuencode"
	default n
	help
	  Please submit a patch to add help text for this item.

config BB_CONFIG_WATCH
	bool "watch"
	default n
	help
	  Please submit a patch to add help text for this item.

config BB_CONFIG_WC
	bool "wc"
	default n
	help
	  Please submit a patch to add help text for this item.

config BB_CONFIG_WHO
	bool "who"
	default n
	help
	  Please submit a patch to add help text for this item.

config BB_CONFIG_WHOAMI
	bool "whoami"
	default n
	help
	  Please submit a patch to add help text for this item.

config BB_CONFIG_YES
	bool "yes"
	default n
	help
	  Please submit a patch to add help text for this item.


comment "Common options for cp and mv"
    depends on BB_CONFIG_CP || BB_CONFIG_MV

config BB_CONFIG_FEATURE_PRESERVE_HARDLINKS
	bool "  Preserve hard links"
	default n
	depends on BB_CONFIG_CP || BB_CONFIG_MV
	help
	  Please submit a patch to add help text for this item.

comment "Common options for ls and more"
    depends on BB_CONFIG_LS || BB_CONFIG_MORE

config BB_CONFIG_FEATURE_AUTOWIDTH
	bool "  Calculate terminal & column widths"
	default n
	depends on BB_CONFIG_LS || BB_CONFIG_MORE
	help
	  Please submit a patch to add help text for this item.


comment "Common options for df, du, ls"
    depends on BB_CONFIG_DF || BB_CONFIG_DU || BB_CONFIG_LS

config BB_CONFIG_FEATURE_HUMAN_READABLE
	bool "  Support for human readable output (example 13k, 23M, 235G)"
	default n
	depends on BB_CONFIG_DF || BB_CONFIG_DU || BB_CONFIG_LS
	help
	  Please submit a patch to add help text for this item.

endmenu
```

## config/busybox/fileutils/Config.in
```kconfig
#
# For a description of the syntax of this configuration file,
# see scripts/kbuild/config-language.txt.
#

menu "File Utilities"
	depends on BUSYBOX

config BB_CONFIG_CHMOD
	bool "chmod"
	default n
	help
	  Please submit a patch to add help text for this item.

config BB_CONFIG_CHOWN
	bool "chown"
	default n
	help
	  Please submit a patch to add help text for this item.

config BB_CONFIG_CHGRP
	bool "chgrp"
	default n
	help
	  Please submit a patch to add help text for this item.

config BB_CONFIG_CP
	bool "cp"
	default n
	help
	  Please submit a patch to add help text for this item.

config BB_CONFIG_DD
	bool "dd"
	default n
	help
	  Please submit a patch to add help text for this item.

config BB_CONFIG_DF
	bool "df"
	default n
	help
	  Please submit a patch to add help text for this item.

config BB_CONFIG_DU
	bool "du"
	default n
	help
	  Please submit a patch to add help text for this item.

config BB_CONFIG_LN
	bool "ln"
	default n
	help
	  Please submit a patch to add help text for this item.

config BB_CONFIG_LS
	bool "ls"
	default n
	help
	  Please submit a patch to add help text for this item.

config BB_CONFIG_FEATURE_LS_FILETYPES
	bool "  Enable filetyping options (-p and -F)"
	default y
	depends on BB_CONFIG_LS
	help
	  Please submit a patch to add help text for this item.

config BB_CONFIG_FEATURE_LS_FOLLOWLINKS
	bool "  Enable symlinks dereferencing (-L)"
	default y
	depends on BB_CONFIG_LS
	help
	  Please submit a patch to add help text for this item.

config BB_CONFIG_FEATURE_LS_RECURSIVE
	bool "  Enable recursion (-R)"
	default y
	depends on BB_CONFIG_LS
	help
	  Please submit a patch to add help text for this item.

config BB_CONFIG_FEATURE_LS_SORTFILES
	bool "  Sort the file names"
	default y
	depends on BB_CONFIG_LS
	help
	  Please submit a patch to add help text for this item.

config BB_CONFIG_FEATURE_LS_TIMESTAMPS
	bool "  Show file timestamps"
	default y
	depends on BB_CONFIG_LS
	help
	  Please submit a patch to add help text for this item.

config BB_CONFIG_FEATURE_LS_USERNAME
	bool "  Show username/groupnames"
	default y
	depends on BB_CONFIG_LS
	help
	  Please submit a patch to add help text for this item.

config BB_CONFIG_FEATURE_LS_COLOR
	bool "  Use color to identify file types"
	default y
	depends on BB_CONFIG_LS
	help
	  Please submit a patch to add help text for this item.

config BB_CONFIG_MKDIR
	bool "mkdir"
	default n
	help
	  Please submit a patch to add help text for this item.

config BB_CONFIG_MKFIFO
	bool "mkfifo"
	default n
	help
	  Please submit a patch to add help text for this item.

config BB_CONFIG_MKNOD
	bool "mknod"
	default n
	help
	  Please submit a patch to add help text for this item.

config BB_CONFIG_MV
	bool "mv"
	default n
	help
	  Please submit a patch to add help text for this item.

config BB_CONFIG_RM
	bool "rm"
	default n
	help
	  Please submit a patch to add help text for this item.

config BB_CONFIG_RMDIR
	bool "rmdir"
	default n
	help
	  Please submit a patch to add help text for this item.

config BB_CONFIG_SYNC
	bool "sync"
	default n
	help
	  Please submit a patch to add help text for this item.

config BB_CONFIG_TOUCH
	bool "touch"
	default n
	help
	  Please submit a patch to add help text for this item.

comment "Common options for cp and mv"
    depends on BB_CONFIG_CP || BB_CONFIG_MV

config BB_CONFIG_FEATURE_PRESERVE_HARDLINKS
	bool "  Preserve hard links"
	default n
	depends on BB_CONFIG_CP || BB_CONFIG_MV
	help
	  Please submit a patch to add help text for this item.

comment "Common options for ls and more"
    depends on BB_CONFIG_LS || BB_CONFIG_MORE

config BB_CONFIG_FEATURE_AUTOWIDTH
	bool "  Calculate terminal & column widths"
	default n
	depends on BB_CONFIG_LS || BB_CONFIG_MORE
	help
	  Please submit a patch to add help text for this item.


comment "Common options for df, du, ls"
    depends on BB_CONFIG_DF || BB_CONFIG_DU || BB_CONFIG_LS

config BB_CONFIG_FEATURE_HUMAN_READABLE
	bool "  Support for human readable output (example 13k, 23M, 235G)"
	default n
	depends on BB_CONFIG_DF || BB_CONFIG_DU || BB_CONFIG_LS
	help
	  Please submit a patch to add help text for this item.

endmenu
```

## config/busybox/ipsvd/Config.in
```kconfig
#
# For a description of the syntax of this configuration file,
# see scripts/kbuild/config-language.txt.
#

menu "ipsvd utilities"
	depends on BUSYBOX

config BB_CONFIG_TCPSVD
	bool "tcpsvd"
	default n
	help
	  tcpsvd listens on a tcp port and runs a program for each new connection

config BB_CONFIG_UDPSVD
	bool "udpsvd"
	default n
	help
	  udpsvd listens on a udp port and runs a program for each new connection

endmenu
```
